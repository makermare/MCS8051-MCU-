/***************************************
*GB2312
*作者：创客海
*内容：独立按键K3外部中断控制发光管
*实验板：新起点51单片机实验板
*单片机型号：STC89C52RC
***************************************/

#include <STC89C5xRC.H>
//#include <INTRINS.H>

sbit K3 = P3^2;//位声明了P3.2引脚为按键K3

void Delay50ms();

void xqd_board() interrupt 0   //进入中断程序执行程序
{
    EX0 = 0;//外部中断0关
    Delay50ms();
    if(K3 == 0)
    {
        while(K3 == 0);     //如果按键没松开就一直循环，等待按键松开
        P1 = ~P1;		    //P1口电平按位取反，0101 0101取反后为1010 1010
    }
    EX0 = 1;//外部中断0开
}

void main()
{
    P1  = 0x55;      //P1口初始值，0x55是0101 0101
    IT0 = 0;        //低电平触发，当为P3.2引脚被接低电平时进入中断，相当于按下K3
    EA  = 1;         //全局中断开
    EX0 = 1;        //外部中断0开

    while(1);     //主程序进入死循环，等待被中断打断
}

void Delay50ms()		//@11.0592MHz
{
    unsigned char i, j;

    i = 90;
    j = 163;
    do
    {
        while (--j);
    }
    while (--i);
}
