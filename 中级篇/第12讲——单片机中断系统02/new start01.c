/***************************************
*GB2312
*作者：创客海
*内容：独立按键K3外部中断控制数码管显示
*实验板：新起点51单片机实验板
*单片机型号：STC89C52RC
***************************************/

#include <STC89C5xRC.H>
#include <INTRINS.H>

//#define uchar unsigned char
//#define uint  unsigned int

sbit LCD_EN = P2 ^ 5;     // 位声明了LCD1602、12864的液晶屏使能端
sbit DS1302_RST = P1 ^ 2; // 位声明了DS1302的温湿度传感器使能端
sbit DUAN = P2 ^ 0;       // 位声明了数码管字段码的锁存器使能端
sbit WEI = P2 ^ 1;        // 位声明了数码管位置码的锁存器使能端
sbit CS88 = P2 ^ 2;       // 位声明了点阵屏行列的列锁存器使能端

sbit K3 = P3^2;//位声明了P3.2引脚为按键K3
sbit K4 = P3^3;//位声明了P3.3引脚为按键K4

//八位共阴数码管段选表
unsigned char code table[]=
{
// 0      1     2     3
    0x3f, 0x06, 0x5b, 0x4f,
// 4      5     6     7
    0x66, 0x6d, 0x7d, 0x07,
// 8      9     A     B
    0x7f, 0x6f, 0x77, 0x7c,
// C      D     E     F     熄灭
    0x39, 0x5e, 0x79, 0x71, 0x00
};

unsigned char a=0;//全局变量，存放数码管的显示值

void Delay50ms();

void xqd_board0() interrupt 0   //进入中断程序执行程序
{
    EX0=0;//外部中断0关
    Delay50ms();
    if(K3 == 0)
    {
        while(K3 == 0);     //如果按键没松开就一直循环，等待按键松开
        a=a+1;		    //数码管的当前显示数字值增加
        P0 = table[a];      //输送段选值，利用数组的下标用于显示a的值
        DUAN = 1;
        DUAN = 0;
    }
    EX0=1;//外部中断0开
}
void xqd_board2() interrupt 2   //进入中断程序执行程序
{
    EX1=0;//外部中断1关
    Delay50ms();
    if(K4 == 0)
    {
        while(K4 == 0);     //如果按键没松开就一直循环，等待按键松开
        a=a-1;		        //数码管的当前显示数字值增加
        P0 = table[a];      //输送段选值，利用数组的下标用于显示a的值
        DUAN = 1;
        DUAN = 0;
    }
    EX1=1;//外部中断1开
}

void main()
{
    LCD_EN = 0;           //如果开发板上有液晶屏，则关闭，避免实验板受到影响
    DS1302_RST = 0;       //关闭开发板上的温湿度传感器，避免实验板受到影响
    DUAN = 0;             //锁住数码管字段码的锁存器使能端
    WEI = 0;              //锁住数码管位置码的锁存器使能端
    CS88 = 0;             //锁住点阵屏行列的列锁存器使能端

    IT0 = 0;        //低电平触发，当为P3.2引脚被接低电平时进入中断，相当于按下K3
    EA  = 1;         //全局中断开
    EX0 = 1;        //外部中断0开
    IT1 = 0;        //低电平触发，当为P3.3引脚被接低电平时进入中断，相当于按下K4
    EX1 = 1;        //外部中断1开

    P0 = 0xaa; // 1010 1010，也就是数码管的公共阴极为低电平的部分，此时的数码管有部分可以显示，注意最左边是低位
    WEI = 1;  //打开数码管位置码的锁存器使能端，使锁存器输出口跟随P0口的数据
    WEI = 0;  //锁住数码管位置码的锁存器使能端，使锁存器输出口保持当前瞬间的数据
    P0 = 0x00; // 0000 0000，也就是数码管的段码全部为低电平，此时的数码管没有内容显示
    DUAN = 1;  //打开数码管字段码的锁存器使能端，使锁存器输出口跟随P0口的数据
    DUAN = 0;  //锁住数码管字段码的锁存器使能端，使锁存器输出口保持当前瞬间的数据
    while(1);     //主程序进入死循环，等待被中断打断,k3/k4
}

void Delay50ms()		//@11.0592MHz
{
    unsigned char i, j;

    i = 90;
    j = 163;
    do
    {
        while (--j);
    }
    while (--i);
}
