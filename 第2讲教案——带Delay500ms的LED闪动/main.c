/****************************************************************
 * 实验板：  创客海51单片机实验板，以STC89C52单片机为核心，适用于51系列单片机
 * 源代码：  源码经过精心调试，逐行注释，倾心录制高品质视频教程，制作PPT文档教程
 * 温馨提示：需要开源例程源码，请到创客海技术论坛学习、讨论、下载！
 * 淘宝店铺：创客海社区一号店/二号店，希望您支持，感谢您的惠顾！
 * 程序目的：学习主函数的创建方法
 * 函数功能: 指示灯间歇闪动
*******************************************************************************/
#include <STC89C5xRC.H>
#include <INTRINS.H >

sbit led1=P1^0;	 //第一个led是和P1^0口连接的。
/*******************************************************************************
* 子函数   : Delay500ms
* 函数功能 : 延时函数，延时500ms
*******************************************************************************/
void 	Delay500ms()		//@11.0592MHz
{
    unsigned char i, j, k;

    _nop_();             //等价于这条语句 extern void  _nop_  ();
    i = 4,j = 129;
    k = 119;
    do                   //do while循环嵌套
    {
        do                 //这是内层的do while循环
        {
            while (--k);     //最里层的while循环
        }
        while (--j);
    }
    while (--i);
}
/*******************************************************************************
* 主函数     : main
* 函数功能   : 指示灯间歇闪动
*******************************************************************************/
void main()
{
    while(1)           //注意，这里不要加分号，因为后面跟着{}，等于说while语句还没有结束
    {

        P10=0;           //点亮led0指示灯，讲解与P1^0  P1_0的区别
        Delay500ms();    //调用延时子函数

        P10=1;           //熄灭LED0指示灯
        Delay500ms();    //调用延时子函数
    }
}
