/***************************************
*GB2312
*作者：创客海
*内容：蜂鸣器项目理论课-蜂鸣器发出不同声音
*实验板：新起点51单片机实验板
*单片机型号：STC89C52RC
***************************************/

#include <STC89C5xRC.H>//引用了头文件，如果没有可用reg51.h代替
//#include <INTRINS.H>//循环左移循环右移必须的函数

sbit FM = P2 ^ 3;//位声明了P2.3引脚为蜂鸣器
/*------------------------------------------------
 延时函数，含有输入参数 unsigned int t，无返回值
 unsigned int 是定义无符号整形变量，其值的范围是
 0~65535
------------------------------------------------*/
void Delay(unsigned int t)
{
    while (--t);
}

//蜂鸣器发出不同声音
void main()//主函数，程序的入口
{
    int i;//定义main函数内的局部变量i
    while (1)//外层循环，用于控制不同声音之间切换
    {
        i = 50;//将i赋值为整数50
        while (i--)//执行i次循环体
        {
            FM = 1; //高电平不发声音
            Delay(200);//调用延时函数，参数200
            FM = 0; //低电平发声音
            Delay(200);
        }
        i = 66;//将i赋值为整数66
        while (i--)//执行i次循环体
        {
            FM = 1; //高电平不发声音
            Delay(150);
            FM = 0; //低电平发声音
            Delay(150);
        }
    }
}
