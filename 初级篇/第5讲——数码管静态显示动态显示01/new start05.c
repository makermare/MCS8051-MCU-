/***************************************
*GB2312
*作者：创客海
*内容：数码管静态显示动态显示理论课-所有数码管静态显示1、2、3
*实验板：新起点51单片机实验板
*单片机型号：STC89C52RC
***************************************/

#include <STC89C5xRC.H>
//#include <INTRINS.H>

sbit LCD_EN = P2 ^ 5;     // 位声明了LCD1602、12864的液晶屏使能端
sbit DS1302_RST = P2 ^ 4; // 位声明了DS1302的温湿度传感器使能端
sbit DUAN = P2 ^ 0;       // 位声明了数码管字段码的锁存器使能端
sbit WEI = P2 ^ 1;        // 位声明了数码管位置码的锁存器使能端
sbit CS88 = P2 ^ 2;       // 位声明了点阵屏行列的列锁存器使能端

//延时函数，由STCisp生成500毫秒的精确延时
void Delay500ms() //@11.0592MHz
{
    unsigned char i, j, k;
    ;
    i = 4;
    j = 129;
    k = 119;
    do
    {
        do
        {
            while (--k);
        }
        while (--j);
    }
    while (--i);
}

void main()
{
    LCD_EN = 0;           //如果开发板上有液晶屏，则关闭，避免实验板受到影响
    DS1302_RST = 0;       //关闭开发板上的温湿度传感器，避免实验板受到影响
    DUAN = 0;             //锁住数码管字段码的锁存器使能端
    WEI = 0;              //锁住数码管位置码的锁存器使能端
    CS88 = 0;             //锁住点阵屏行列的列锁存器使能端

    //P0 = 0x06; // 0000 0110，也就是所有数码管的阳极都是字符1的段码
    //DUAN = 1;  //打开数码管字段码的锁存器使能端，使锁存器输出口跟随P0口的数据
    //DUAN = 0;  //锁住数码管字段码的锁存器使能端，使锁存器输出口保持当前瞬间的数据

    //P0 = 0xfe; // 1111 1110，也就是数码管最左边的公共阴极为低电平，此时最左边的数码管才可以显示，注意最左边是低位
    //WEI = 1;  //打开数码管位置码的锁存器使能端，使锁存器输出口跟随P0口的数据
    //WEI = 0;  //锁住数码管位置码的锁存器使能端，使锁存器输出口保持当前瞬间的数据

    //Delay500ms();//执行延时函数，延时500毫秒

    while (1)//死循环，改变数码管的显示情况
    {
        P0 = 0x06; // 0000 0110，也就是所有数码管的阳极都是字符1的段码
        DUAN = 1;  //打开数码管字段码的锁存器使能端，使锁存器输出口跟随P0口的数据
        DUAN = 0;  //锁住数码管字段码的锁存器使能端，使锁存器输出口保持当前瞬间的数据

        P0 = 0x00; // 0000 0000，也就是数码管所有的公共阴极为低电平，此时所有的数码管都可以显示，注意最左边是低位
        WEI = 1;  //打开数码管位置码的锁存器使能端，使锁存器输出口跟随P0口的数据
        WEI = 0;  //锁住数码管位置码的锁存器使能端，使锁存器输出口保持当前瞬间的数据

        Delay500ms();//执行延时函数，延时500毫秒

        P0 = 0x5b; // 0101 1011，也就是所有数码管的阳极都是字符2的段码
        DUAN = 1;  //打开锁存器
        DUAN = 0;  //锁住

        P0 = 0x00; // 0000 0000
        WEI = 1;
        WEI = 0;

        Delay500ms();

        P0 = 0x4f; // 0100 1111，也就是所有数码管的阳极都是字符3的段码
        DUAN = 1;  //开
        DUAN = 0;  //锁

        P0 = 0x00;
        WEI = 1;
        WEI = 0;

        Delay500ms();
    }
}
