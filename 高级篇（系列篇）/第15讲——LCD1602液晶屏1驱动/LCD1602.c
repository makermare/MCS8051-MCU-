/****************************************************************
 * 实验板：  创客海51单片机实验板源代码，适用于STC89C52系列单片机
 * 温馨提示：代码精心调试，开源免费，希望得到您的支持，技术问题请到创客海论坛交流
 * 淘宝店铺：创客海社区一号店，感谢您的光临！
 * 程序目的：学习lcd显示应用,学习数组，
 * 函数功能: LCD驱动程序
*******************************************************************************/
#include <STC89C5xRC.H>

#define LCD1602_DB  P0      //data bus 液晶屏数据总线

sbit LCD1602_RS = P1^0;     //数据=1，命令=0
sbit LCD1602_RW = P1^1;     //读=1，写=0
sbit LCD1602_EN = P2^5;	    //下降沿

sbit LCD_EN = P2 ^ 5;     // 位声明了LCD1602、12864的液晶屏使能端
sbit DS1302_RST = P1 ^ 2; // 位声明了DS1302的温湿度传感器使能端
sbit DUAN = P2 ^ 0;       // 位声明了数码管字段码的锁存器使能端
sbit WEI = P2 ^ 1;        // 位声明了数码管位置码的锁存器使能端
sbit CS88 = P2 ^ 2;       // 位声明了点阵屏行列的列锁存器使能端

/*******************************************************************************
* 子函数     : Delay1ms
* 函数功能	 : 延时函数，延时1ms
*******************************************************************************/
void DelayXms(unsigned int ms)      //@11.0592MHz
{
    while(ms--)   //括弧内的MS--,等效与ms=ms-1，先判断后减1
    {
        unsigned char i=2, j=199;
        ;       //这里加的1个分号，是空操作
        do
        {
            while (--j);
        }
        while (--i);
    }
}
/*******************************************************************************
* 初始化写命令 :Close_Display_LED
* 函数功能	   :消除数码管、LED点阵屏,避免干扰LDC1602
*******************************************************************************/
void Close_Display_LED()
{
    LCD_EN = 0;           //如果开发板上有液晶屏，则关闭，避免实验板受到影响
    DS1302_RST = 0;       //关闭开发板上的温湿度传感器，避免实验板受到影响
    DUAN = 0;             //锁住数码管字段码的锁存器使能端
    WEI = 0;              //锁住数码管位置码的锁存器使能端
    CS88 = 0;             //锁住点阵屏行列的列锁存器使能端

    LCD1602_DB=0xFF;    //总线送数据0xFF,必须是0xFF，才能消除干扰
}
/*******************************************************************************
* 初始化写命令 :Lcd1602_Init_Write_Cmd
* 函数功能	   :初始化写命令，初始的几个调用，不检测忙信号
*******************************************************************************/
void Lcd1602_Init_Write_Cmd(unsigned char cmd)
{
    LCD1602_RS = 0;     //命令选择
    LCD1602_RW = 0;     //写命令
    LCD1602_DB = cmd;   //命令送到总线上
    LCD1602_EN = 1;     //1个上升沿
    LCD1602_EN = 0;     //1个下降沿，数据就进入LCD模块了
}
/*******************************************************************************
* 读忙子函数 :Read_Busy()
* 函数功能	 :都状态字的第7位，=1忙，=0不忙
*******************************************************************************/
void Read_Busy()         //一定要忙检测，判断bit7，是0允许执行，是1禁止
{
    unsigned char sta;     //临时定义个变量
    LCD1602_DB = 0xff;     //总线准备接收数据
    LCD1602_RS = 0;        //命令选择
    LCD1602_RW = 1;        //读
    do
    {
        LCD1602_EN = 1;      //1个上升沿
        sta = LCD1602_DB;
        LCD1602_EN = 0;      //1个下降沿，数据到总线上了，用完就拉低，释放总线
    }
    while(sta & 0x80);     //判断第7位是否=0，等于0结束循环，跳出子函数
}
/*******************************************************************************
* 写命令子函数 :Lcd1602_Write_Cmd
* 函数功能	   :都状态字的第7位，=1忙，=0不忙
*******************************************************************************/
void Lcd1602_Write_Cmd(unsigned char cmd)     //写命令
{
    Read_Busy();        //一定要忙检测，判断bit7，是0允许执行，是1禁止
    LCD1602_RS = 0;     //命令选择
    LCD1602_RW = 0;     //写命令
    LCD1602_DB = cmd;   //命令送到总线上
    LCD1602_EN = 1;     //1个上升沿
    LCD1602_EN = 0;     //1个下降沿，数据就进入LCD模块了
}
/*******************************************************************************
* 写数据子函数 :Lcd1602_Write_Data
* 函数功能	   :都状态字的第7位，=1忙，=0不忙
*******************************************************************************/
void Lcd1602_Write_Data(unsigned char dat)   //写数据
{
    Read_Busy();        //忙检测函数，判断bit7，是0允许执行，是1禁止
    LCD1602_RS = 1;     //选择数据
    LCD1602_RW = 0;     //写命令
    LCD1602_DB = dat;   //数据送到总线上
    LCD1602_EN = 1;     //1个上升沿
    LCD1602_EN = 0;     //1个下降沿，数据就进入LCD模块了
}
/*******************************************************************************
* LCD初始化子函数  :InitLcd1602()
* 函数功能	       :设置LCD模块的工作状态，完毕后，然后就能正常显示了
*******************************************************************************/
void InitLcd1602()                 //1602初始化
{
    Close_Display_LED();           //关数码管点阵屏驱动芯片，避免LCD1602受干扰
    DelayXms(10);
    Lcd1602_Init_Write_Cmd(0x38);  //初始的，
    DelayXms(5);
    Lcd1602_Init_Write_Cmd(0x38);  //初始的，不检测忙信号
    DelayXms(5);
    Lcd1602_Write_Cmd(0x38);       //8位数据接口，2行显示，5*7点阵
    Lcd1602_Write_Cmd(0x0c);       //开显示，关光标，关闪烁
    Lcd1602_Write_Cmd(0x06);       //数据读写操作后，光标自动加1，画面不动
    Lcd1602_Write_Cmd(0x01);       //光标复位，清屏
}
/*******************************************************************************
* 光标指针子函数 :LcdSetCursor
* 函数功能	     :修正LCD模块规定的地址，等待写入显示数据
*                 x是行坐标，y是列坐标
*******************************************************************************/
void LcdSetCursor(unsigned char x,unsigned char y)
{
    unsigned char addr;
    if(x == 0)
        addr = 0x00 + y;          //LCD第一行地址
    else
        addr = 0x40 + y;          //LCD第二行地址

    Lcd1602_Write_Cmd(addr|0x80); //数据指针还的加上0x80
}
/*******************************************************************************
* 显示一个字符 :LCD_ShowChar
* 函数功能	   :x是行坐标0~1，y是列坐标0~15，Ch是要显示的字符
*******************************************************************************/
void LCD_ShowChar(unsigned char x,unsigned char y,unsigned char Ch)
{
    LcdSetCursor(x,y);
    Lcd1602_Write_Data(Ch);
}
/*******************************************************************************
* 显示字符串 :LcdShowString
* 函数功能	 ::x是行坐标0~1，y是列坐标0~15，*str是要显示的字符串指针
*******************************************************************************/
void Lcd_ShowStr(unsigned char x,unsigned char y,unsigned char *str)
{
    LcdSetCursor(x,y);           //当前字符的坐标，X=0是第一行，Y=0是第一列
    while(*str != '\0')          //检测数组的结束符，这个'\0'就是0x00
    {
        Lcd1602_Write_Data(*str++);//显示数组内的字符，*str是自定义的字符串数组指针
    }
}
/*******************************************************************************
* 进制数的n次方  :用于拆分数字，比如798这个数，要除以100再取余，才能将7分离出来
* 函数功能       :比如10进制数M，用10的（Length长度减1）次方，这里Length=3，得到100，用于分离798中的7
                 :此子函数也适用于二进制，16进制
*         	     :将显示数拆分成单个的数，再将单个数按ASCii码表中字符，逐个显示
*******************************************************************************/
int LCD_Pow(int M,int n)   //10进制时M=10,16进制时M=16，二进制时M=2
{
    unsigned char i;
    int Result=1;

    for(i=0; i<n; i++)
    {
        Result*=M;       //循环相乘n-1次，这个n其实就是数字长度Length
    }
    return Result;     //返回进制数的n次方
}
/*******************************************************************************
* 显示10进制数字   :在指定位置显示数字
* 函数功能	       :将显示数拆分成单个的数，再将这个数按ASCii码表中字符，逐个显示
  x行坐标范围0~1，y列坐标范围：0~15，显的数字Number范围：0~65535，长度Length范围：1~5
*******************************************************************************/
void LCD_ShowNum(unsigned char x,unsigned char y,unsigned int Number,unsigned char Length)
{
    unsigned char i;
    LcdSetCursor(x,y);         //当前字符的坐标，X=0是第0行，Y=0是第0列
    for(i=Length; i>0; i--)
    {
        //显示数字Number，除以10的n减1次方，再取余，就拆分出最高位的数，再加上'0'的地址0x30
        //就对应了ASCii码表中字符，调用显示一个字符子函数，
        Lcd1602_Write_Data('0'+Number/LCD_Pow(10,i-1)%10);
    }
}
/*******************************************************************************
* 显示16进制数 :在LCD1602指定位置，以十六进制显示所给数字
* 函数功能	   :将显示数拆分成单个的数，再将这个数按ASCii码表中字符，逐个显示
  x范围0~1，y范围：0~15，显的数字Number范围：0~0xFFFF，长度Length范围：1~4
*******************************************************************************/
void LCD_ShowHexNum(unsigned char x,unsigned char y,unsigned int Number,unsigned char Length)
{
    unsigned char i;
    unsigned char SingleNumber;
    LcdSetCursor(x,y);          //当前字符的坐标，X=0是第0行，Y=0是第0列
    for(i=Length; i>0; i--)
    {
        SingleNumber=Number/LCD_Pow(16,i-1)%16;	 //依次拆分成单个的数
        if(SingleNumber<10)
            Lcd1602_Write_Data('0'+SingleNumber);		   //将拆分出来的单数与ASCii码表对应，调用显示一个字符
        else
            Lcd1602_Write_Data('A'+SingleNumber-10);    //将拆分出来的字母与ASCii码表对应，调用显示一个字符
    }
}