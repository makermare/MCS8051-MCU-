/***************************************
*GB2312
*作者：创客海
*内容：点阵屏动态显示ILOVEU轮播动画
*实验板：新起点51单片机实验板
*单片机型号：STC89C52RC
***************************************/

#include <STC89C5xRC.H>
#include <INTRINS.H>

sbit LCD_EN = P2 ^ 5;     // 位声明了LCD1602、12864的液晶屏使能端
sbit DS1302_RST = P2 ^ 4; // 位声明了DS1302的温湿度传感器使能端
sbit DUAN = P2 ^ 0;       // 位声明了数码管字段码的锁存器使能端
sbit WEI = P2 ^ 1;        // 位声明了数码管位置码的锁存器使能端
sbit CS88 = P2 ^ 2;       // 位声明了点阵屏行列的列锁存器使能端

/*******************************************************************************
 * 延时子函数 : Delay1ms
 * 函数功能	 : 延时1ms
 *******************************************************************************/
void Delay100us() //@11.0592MHz
{
    unsigned char i;

    ;
    i = 43;
    while (--i)
        ;
}
void Delaynus(unsigned int Xus) //@11.0592MHz
{
    while (Xus--)
    {
        Delay100us();
    }
}

/*******************************************************************************
* 点阵屏子程序  : XDisplay
* 函数功能	    : 列数据DisData形参，第几列Sit形参
*     把每一列要显示的数据，装在数组里，整幅画面共有8列，就是8个数据
				  从左边第一列开始显示，向右扫描
*******************************************************************************/
void XDisplay(unsigned char DisData, Sit)
{
    P0 = 0xff; //送显示位置，列码Sit，让数据显示在第几列
    CS88 = 1;
    CS88 = 0; //锁住位码到UB（74HC573）内

    P0 = DisData; //送其中1列要显示的数据,
    DUAN = 1;
    DUAN = 0; //锁住数据到UA（74HC573）内

    P0 = ~(0x80 >> Sit); //送显示位置，列码Sit，让数据显示在第几列
    CS88 = 1;
    CS88 = 0; //锁住位码到UB（74HC573）内
}

/*******************************************************************************
* 主程序    : 动画点阵屏显示程序
* 函数功能	: 动态扫描点阵屏显示，调用点阵屏列显示子程序，2个形参
			  从左边第一列开始显示，
*       3个参数,i=画面中的列指针，Map=画面指针，Stay=画面停留时间
*******************************************************************************/
void main()
{
    unsigned char idata Num[] =
    {
        0x00,  0x81,  0x81,  0xFF,  0xFF,  0x81,  0x81,  0x00,
        0x00,  0xFF,  0xFF,  0x03,  0x03,  0x03,  0x03,  0x00,
        0x00,  0x7E,  0xFF,  0xC3,  0xC3,  0xFF,  0x7E,  0x00,
        0x00,  0xFC,  0xFE,  0x03,  0x03,  0xFE,  0xFC,  0x00,
        0x00,  0xFF,  0xFF,  0xDB,  0xDB,  0xDB,  0xDB,  0x00,
        0x00,  0xFE,  0xFF,  0x03,  0x03,  0xFF,  0xFE,  0x00,

    }; //显示“ILOVEU”

    LCD_EN = 0;           //如果开发板上有液晶屏，则关闭，避免实验板受到影响
    DS1302_RST = 0;       //关闭开发板上的温湿度传感器，避免实验板受到影响
    DUAN = 0;             //锁住数码管字段码的锁存器使能端
    WEI = 0;              //锁住数码管位置码的锁存器使能端
    CS88 = 0;             //锁住点阵屏行列的列锁存器使能端

    while (1)
    {
        unsigned char i, Map, Stay;	   // Map=画面指针，Stay=动画停留时间
        for (Map = 0; Map < 40; Map++) //修改画面指针
        {
            for (Stay = 0; Stay < 20; Stay++) // Stay<10,画面停留时间=10ms*8*20，大概1.6秒
            {
                for (i = 0; i < 8; i++) //显示整幅动画内容，扫描8列
                {
                    XDisplay(Num[i + Map], i); //调用子程序，i=画面中的列指针,Map=画面指针
                    Delaynus(10);			   //每一列停留时间10ms
                }
            }
        }
    }
}