/****************************************************************
 * 实验板：  创客海51单片机实验板，以STC89C52单片机为核心，适用于51系列单片机
 * 源代码：  源码经过精心调试，逐行注释，倾心录制高品质视频教程，制作PPT文档教程
 * 温馨提示：需要开源例程源码，请到创客海技术论坛学习、讨论、下载！
 * 淘宝店铺：创客海社区一号店/二号店，希望您支持，感谢您的惠顾！
 * 程序目的：学习主函数的创建方法
 * 函数功能: 创建流水灯方法，IF语句的用法
*******************************************************************************/

#include <STC89C5xRC.H>

sbit K1 = P3^0;//位声明了P3.0引脚为按键K1
sbit K2 = P3^1;//位声明了P3.1引脚为按键K2
sbit K3 = P3^2;//位声明了P3.2引脚为按键K3
sbit K4 = P3^3;//位声明了P3.3引脚为按键K4
sbit K5 = P3^4;//位声明了P3.4引脚为按键K5
sbit K6 = P3^5;//位声明了P3.5引脚为按键K6
sbit K7 = P3^6;//位声明了P3.6引脚为按键K7
sbit K8 = P3^7;//位声明了P3.7引脚为按键K8
/*******************************************************************************
* 延时子函数 : Delay1ms
* 函数功能     : 延时1ms
*******************************************************************************/
void Delay1ms(unsigned int Xms)        //@11.0592MHz
{
    while(Xms--)
    {
        unsigned char i, j;
        ;
        i = 2;
        j = 199;
        do
        {
            while (--j);
        }
        while (--i);
    }
}

/*******************************************************************************
* 主函数   : main
* 函数功能 : 按一下K3键，LED灯左移一次,if语句判断按键动作
*******************************************************************************/
void main()
{
    unsigned char n=0,Num=0x01;

    while(1)                    //主循环体
    {
        if(K1==0)               //判断K1键是否按下，P30==0时被按下
        {
            Delay1ms(50);       //消抖
            if(K1==0)           //判断K1键是否按下，P30==0时被按下
            {
                while(K1==0);   //等待按键释放

                P1=~(Num<<n);   //左移n位，再取反，因为==0时才能亮
                Delay1ms(200);  //延时200毫秒
                n++;            //修正移动位数

                if(n>=8)        //判断是否左移到最左侧
                    n=0;        //省略了花括弧，如果移动到最左侧，参数清零
            }
        }
    }
}

